## plnx/orbit_fpga/project-spec/configs/rootfsconfigs/Kconfig.user
```kconfig
menu "user packages " 
config buttons  
	 bool "buttons"
	 help
	
config gpio-demo  
	 bool "gpio-demo"
	 help
	
config lcd  
	 bool "lcd"
	 help
	
config peekpoke  
	 bool "peekpoke"
	 help
	
config py-krpc  
	 bool "py-krpc"
	 help
	
config py-protobuf  
	 bool "py-protobuf"
	 help
	
config xadc-init  
	 bool "xadc-init"
	 help
	
endmenu
```
